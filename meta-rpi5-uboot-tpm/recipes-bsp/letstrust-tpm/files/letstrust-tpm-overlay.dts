/dts-v1/;
/plugin/;

/ {
    compatible = "brcm,bcm2835";

    /* Enable spi0 */
    fragment@0 {
        target = <&spi0>;
        __overlay__ { status = "okay"; };
    };

    /* Disable spidev on CE1 (common conflict) */
    fragment@1 {
        target = <&spidev1>;
        __overlay__ { status = "disabled"; };
    };

    /* Add/patch the TPM node on CE1 (reg = 1) */
    fragment@2 {
        target = <&spi0>;
        __overlay__ {
            #address-cells = <1>;
            #size-cells = <0>;

            slb9670: slb9670@1 {
                compatible = "infineon,slb9670", "tis,tpm2-spi", "tcg,tpm_tis-spi";
                reg = <1>;                /* CE1 */
                spi-max-frequency = <32000000>;
                status = "okay";
            };
        };
    };
};